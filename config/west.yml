## config/west.yml
```yaml
manifest:
  remotes:
    - name: srwooten2
      url-base: https://github.com/srwooten2
  projects:
    - name: srwooten2
      remote: srwooten2
      revision: main
      import: app/west.yml
  self:
    path: config
```
